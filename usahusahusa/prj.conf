## CMakeLists.txt
```
# SPDX-License-Identifier: Apache-2.0

cmake_minimum_required(VERSION 3.20.0)

find_package(Zephyr REQUIRED HINTS $ENV{ZEPHYR_BASE})
project(usahusahusa)

target_sources(app PRIVATE src/main.cpp)
```

## prj.conf
```kconfig
CONFIG_CPP=y
CONFIG_REQUIRES_FULL_LIBCPP=y

# POSIX API com suporte a threads
CONFIG_POSIX_API=y
CONFIG_DYNAMIC_THREAD=y
CONFIG_THREAD_STACK_INFO=y
CONFIG_DEBUG_THREAD_INFO=y
CONFIG_DYNAMIC_THREAD_POOL_SIZE=6
CONFIG_POSIX_THREAD_THREADS_MAX=6

# Console via UART (redirecionado para USB CDC no overlay)
CONFIG_CONSOLE=y
CONFIG_PRINTK=y
CONFIG_STDOUT_CONSOLE=y

# Logs
CONFIG_LOG=y
CONFIG_LOG_DEFAULT_LEVEL=1
```

## boards/rpi_pico2_rp2350a_m33_w.conf
```kconfig
# Configurações específicas RP2350
CONFIG_LED_STRIP=y

#Console
CONFIG_UART_CONSOLE=y
CONFIG_LOG_DEFAULT_LEVEL=3
CONFIG_SERIAL=y
CONFIG_UART_LINE_CTRL=y
CONFIG_CONSOLE=y
CONFIG_STDOUT_CONSOLE=y

#USB 
CONFIG_USB_DEVICE_STACK_NEXT=y
CONFIG_USBD_CDC_ACM_CLASS=y
CONFIG_CDC_ACM_SERIAL_INITIALIZE_AT_BOOT=y
```

## boards/rpi_pico2_rp2350a_m33_w.overlay
```dts
/ {
    chosen {
        zephyr,console = &cdc_acm_uart0;
        zephyr,shell-uart = &cdc_acm_uart0;
    };
};

&usbd {
    cdc_acm_uart0: cdc_acm_uart0 {
        compatible = "zephyr,cdc-acm-uart";
        label = "CDC_ACM_0";
    };
};
```

## src/main.cpp
```c
/*
 * Copyright (c) 2015-2016 Wind River Systems, Inc.
 *
 * Licensed under the Apache License, Version 2.0 (the "License");
 * you may not use this file except in compliance with the License.
 * You may obtain a copy of the License at
 *
 *     http://www.apache.org/licenses/LICENSE-2.0
 */

#include <zephyr/kernel.h>
#include <zephyr/drivers/led_strip.h>
#include <zephyr/device.h>
#include <zephyr/sys/printk.h>
#include <zephyr/devicetree.h>
#include <pthread.h>
#include <unistd.h>
#include <errno.h>
#include <stdio.h>

/* Converte HSV para RGB */
static void hsv_to_rgb(uint16_t hue, uint8_t saturation, uint8_t value, struct led_rgb *rgb)
{
    uint8_t region, remainder, p, q, t;

    if (saturation == 0) {
        rgb->r = rgb->g = rgb->b = value * 255 / 100;
        return;
    }

    region = hue / 60;
    remainder = (hue % 60) * 255 / 60;

    p = (value * (100 - saturation)) / 100;
    q = (value * (100 - (saturation * remainder) / 255)) / 100;
    t = (value * (100 - (saturation * (255 - remainder)) / 255)) / 100;

    value = value * 255 / 100;
    p = p * 255 / 100;
    q = q * 255 / 100;
    t = t * 255 / 100;

    switch (region) {
    case 0: rgb->r = value; rgb->g = t; rgb->b = p; break;
    case 1: rgb->r = q; rgb->g = value; rgb->b = p; break;
    case 2: rgb->r = p; rgb->g = value; rgb->b = t; break;
    case 3: rgb->r = p; rgb->g = q; rgb->b = value; break;
    case 4: rgb->r = t; rgb->g = p; rgb->b = value; break;
    default: rgb->r = value; rgb->g = p; rgb->b = q; break;
    }
}

/* Thread LED */
#ifdef CONFIG_LED_STRIP
void *led_thread(void *arg)
{
    (void)arg;

    const struct device *strip = DEVICE_DT_GET(DT_NODELABEL(ws2812));
    if (!device_is_ready(strip)) {
        printk("LED strip not ready - thread LED não iniciada\n");
        return NULL;
    }

    printk("Thread LED: arco-íris iniciado\n");

    struct led_rgb pixel[16];
    uint16_t hue = 0;

    while (1) {

        for (int i = 0; i < 16; i++) {
            hue = (hue + 1) % 360;
            hsv_to_rgb(hue, 80, 4, &pixel[i]);
        }
        led_strip_update_rgb(strip, pixel, 16);

        usleep(50000);
    }

    return NULL;
}
#endif

/* Thread de tarefa genérica (comum a todas boards) */
static void *task_thread(void *arg)
{
    (void)arg;

    printk("Thread Task: iniciando\n");
    uint32_t counter = 0;

    while (1) {
        printk("Task [%s]: contador = %u\n", CONFIG_BOARD, counter++);
        sleep(2);
    }

    return NULL;
}

int main(void)
{
    int ret;
    struct sched_param param;

    k_sleep(K_MSEC(5000));

    printk("===================================\n");
    printk("Hello World! Board: %s\n", CONFIG_BOARD);
    printk("===================================\n");

    pthread_t task_tid;
    pthread_t led_tid;
    pthread_attr_t task_attr;
#ifdef CONFIG_LED_STRIP
    pthread_attr_t led_attr;
#endif

    // Task: atributos sem stack explícita
    ret = pthread_attr_init(&task_attr);
    if (ret) { printk("ERRO pthread_attr_init: %d\n", ret); return -1; }
    pthread_attr_setstacksize(&task_attr, 4096);
    pthread_attr_setschedpolicy(&task_attr, SCHED_FIFO);
    param.sched_priority = 3;
    pthread_attr_setschedparam(&task_attr, &param);
    ret = pthread_create(&task_tid, &task_attr, task_thread, NULL);
    if (ret) { printk("ERRO pthread_create Task: %d\n", ret); return -1; }

#ifdef CONFIG_LED_STRIP
    // LED: atributos sem stack explícita
    ret = pthread_attr_init(&led_attr);
    if (ret) { printk("ERRO pthread_attr_init led: %d\n", ret); return -1; }
    pthread_attr_setstacksize(&led_attr, 2048);
    pthread_attr_setschedpolicy(&led_attr, SCHED_FIFO);
    param.sched_priority = 5;
    pthread_attr_setschedparam(&led_attr, &param);
    ret = pthread_create(&led_tid, &led_attr, led_thread, NULL);
    if (ret) { printk("ERRO pthread_create LED: %d\n", ret); return -1; }
#endif

    printk("Threads POSIX iniciadas com sucesso\n");

    while (1) {
        printk("Main thread alive\n");
        k_msleep(5000);
    }

    return 0;
}
```
