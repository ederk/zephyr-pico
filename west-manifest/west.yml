## west-manifest/west.yml
```yaml
manifest:
  remotes:
    - name: zephyrproject
      url-base: https://github.com/zephyrproject-rtos
  projects:
    - name: zephyr
      repo-path: zephyr
      remote: zephyrproject
      revision: main
      clone-depth: 1
      import:
        path-prefix: external
        name-allowlist:
          - cmsis_6
          - picolibc
          - segger
          - hal_nxp
          - hal_rpi_pico
          - hal_stm32
```
